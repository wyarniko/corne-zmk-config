## Kconfig
```kconfig
config RGB_PRO_EYELASH_CALIBRATE
    bool "LED map calibration mode"
    depends on RGB_PRO
    help
      Pressing a key lights the LED with the same index (key N -> LED N)
      and keeps it lit until the next press. Used with the LED mapper page
      to find each half's real LED chain order.
```

## config/west.yml
```yaml
manifest:
  remotes:
    - name: zmkfirmware
      url-base: https://github.com/zmkfirmware
    - name: cormoran
      url-base: https://github.com/cormoran
    - name: m165437
      url-base: https://github.com/M165437
    - name: jagonmo
      url-base: https://github.com/jagonmo
  projects:
    - name: eyelash_corne
      url: https://github.com/a741725193/zmk-new_corne
      revision: main
    - name: zmk
      remote: cormoran
      revision: v0.3-branch+dya
      import: app/west.yml
    - name: zmk-behavior-runtime-sensor-rotate
      remote: cormoran
      revision: main
    - name: zmk-module-ble-management
      remote: cormoran
      revision: zmk-v0.3.0.0
    - name: zmk-module-battery-history
      remote: cormoran
      revision: main
    - name: zmk-module-settings-rpc
      remote: cormoran
      revision: main
    - name: zmk-module-runtime-input-processor
      remote: cormoran
      revision: zmk-v0.3.0.0
    - name: nice-view-gem
      remote: m165437
      revision: v0.3.0
    - name: zmk-pro-rgb
      remote: jagonmo
      revision: 787a41ad94621967973f470f0a561586b6beaa73
  self:
    path: config
```
